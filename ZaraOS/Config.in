## ZaraOS/configs/zaraos_pi5_defconfig
```kconfig
# ===================================================================
# ZaraOS Raspberry Pi 5 Buildroot Configuration
# ===================================================================
# Complete Buildroot defconfig for Raspberry Pi 5 targeting ML workloads
# and humanoid robotics applications.
#
# Documentation:
# - Buildroot Manual: https://buildroot.org/downloads/manual/manual.html
# - Pi 5 Support: https://buildroot.org/downloads/manual/manual.html#_raspberry_pi
# - Defconfig Format: https://buildroot.org/downloads/manual/manual.html#_using_buildroot_s_default_configurations
#
# Target: Raspberry Pi 5 B (4GB/8GB models)
# Architecture: AArch64 (64-bit ARM)
# Kernel: 6.12 (Raspberry Pi kernel fork)
# ===================================================================

# ┌─────────────────────────────────────────────────────────────────┐
# │ TARGET ARCHITECTURE                                             │
# └─────────────────────────────────────────────────────────────────┘

# 64-bit ARM architecture for Pi 5
BR2_aarch64=y

# Cortex-A76 CPU (Pi 5 specific) - enables optimizations
BR2_cortex_a76=y

# ┌─────────────────────────────────────────────────────────────────┐
# │ TOOLCHAIN CONFIGURATION                                         │
# └─────────────────────────────────────────────────────────────────┘

BR2_TOOLCHAIN_BUILDROOT=y
BR2_TOOLCHAIN_BUILDROOT_CXX=y
BR2_TOOLCHAIN_BUILDROOT_FORTRAN=y
BR2_PACKAGE_HOST_LINUX_HEADERS_CUSTOM_TARBALL=y
BR2_PACKAGE_HOST_LINUX_HEADERS_CUSTOM_TARBALL_LOCATION="$(call github,raspberrypi,linux,8f77e03530f65209a377d25023e912b288e039cd)/linux-8f77e03530f65209a377d25023e912b288e039cd.tar.gz"
BR2_TOOLCHAIN_HEADERS_SAME_AS_KERNEL=y
BR2_PACKAGE_HOST_LINUX_HEADERS_CUSTOM_6_12=y
BR2_TOOLCHAIN_BUILDROOT_GLIBC=y

# ┌─────────────────────────────────────────────────────────────────┐
# │ BUILD SYSTEM CONFIGURATION                                      │
# └─────────────────────────────────────────────────────────────────┘

# Apply ZaraOS-specific patches
BR2_GLOBAL_PATCH_DIR="$(BR2_EXTERNAL_ZaraOS_PATH)/patches"

# Verify package hashes for security
BR2_DOWNLOAD_FORCE_CHECK_HASHES=y

# ┌─────────────────────────────────────────────────────────────────┐
# │ SYSTEM CONFIGURATION                                            │
# └─────────────────────────────────────────────────────────────────┘

# Init system - use BusyBox init (lightweight and sufficient)
BR2_INIT_BUSYBOX=y

# Target skeleton filesystem (provides basic directory structure)
BR2_ROOTFS_SKELETON_DEFAULT=y

# System configuration
BR2_TARGET_GENERIC_HOSTNAME="zaraos"
BR2_TARGET_GENERIC_ISSUE="Welcome to ZaraOS"

# BusyBox configuration
BR2_PACKAGE_BUSYBOX=y
BR2_PACKAGE_BUSYBOX_CONFIG="$(BR2_EXTERNAL_ZaraOS_PATH)/configs/busybox-minimal.config"

# Enable DHCP on eth0 for automatic network configuration
BR2_SYSTEM_DHCP="eth0"

# ZaraOS filesystem overlay - applies custom files to rootfs
BR2_ROOTFS_OVERLAY="$(BR2_EXTERNAL_ZaraOS_PATH)/overlays"

# Post-build script - for cleanup tasks only
BR2_ROOTFS_POST_BUILD_SCRIPT="$(BR2_EXTERNAL_ZaraOS_PATH)/scripts/post-build.sh"

# Post-image script - generates final SD card image
BR2_ROOTFS_POST_IMAGE_SCRIPT="$(BR2_EXTERNAL_ZaraOS_PATH)/scripts/post-image.sh"

# ┌─────────────────────────────────────────────────────────────────┐
# │ LINUX KERNEL CONFIGURATION                                     │
# └─────────────────────────────────────────────────────────────────┘

# Enable Linux kernel build
BR2_LINUX_KERNEL=y

# Use custom tarball from Raspberry Pi kernel repository
BR2_LINUX_KERNEL_CUSTOM_TARBALL=y

# Specific Pi kernel commit - known stable version for Pi 5
# This version includes Pi 5 hardware support and optimizations
BR2_LINUX_KERNEL_CUSTOM_TARBALL_LOCATION="$(call github,raspberrypi,linux,8f77e03530f65209a377d25023e912b288e039cd)/linux-8f77e03530f65209a377d25023e912b288e039cd.tar.gz"
# Use Pi 5 specific kernel defconfig (bcm2712)
BR2_LINUX_KERNEL_DEFCONFIG="bcm2712"
#BR2_LINUX_KERNEL_DEFCONFIG="defconfig"

# Apply custom kernel configuration fragment
# This enables 16K page size as standard for Pi 5
BR2_LINUX_KERNEL_CONFIG_FRAGMENT_FILES="$(BR2_EXTERNAL_ZaraOS_PATH)/kernel-fragments/linux-pi5.fragment"

# Kernel requires OpenSSL for module signing
BR2_LINUX_KERNEL_NEEDS_HOST_OPENSSL=y

# FORCE 16k PAGE SIZE FOR PI 5 OPTIM THIS HAS TO ALSO BE CHANGES IN THE KERNAL PATCH!
BR2_ARM64_PAGE_SIZE_16K=y
BR2_ARM64_PAGE_SIZE="16K"

# ┌─────────────────────────────────────────────────────────────────┐
# │ PACKAGE SELECTION                                               │
# └─────────────────────────────────────────────────────────────────┘

# Allow showing packages provided by BusyBox (for debugging)
BR2_PACKAGE_BUSYBOX_SHOW_OTHERS=y

# XZ compression utilities (useful for package management)
BR2_PACKAGE_XZ=y

# Python 3 with bytecode-only installation
BR2_PACKAGE_PYTHON3=y
BR2_PACKAGE_PYTHON3_PY_PYC_ONLY=y     # No .py source files
BR2_PACKAGE_PYTHON3_PYC_ONLY=y        # Bytecode only

# Essential C library support
BR2_PACKAGE_LIBFFI=y

# ┌─────────────────────────────────────────────────────────────────┐
# │ RASPBERRY PI FIRMWARE                                           │
# └─────────────────────────────────────────────────────────────────┘

# Raspberry Pi GPU firmware and bootloader
BR2_PACKAGE_RPI_FIRMWARE=y

# Use ZaraOS Pi 5 specific boot configuration
BR2_PACKAGE_RPI_FIRMWARE_CONFIG_FILE="$(BR2_EXTERNAL_ZaraOS_PATH)/boot-configs/config_5.txt"

# Use ZaraOS Pi 5 specific kernel command line
BR2_PACKAGE_RPI_FIRMWARE_CMDLINE_FILE="$(BR2_EXTERNAL_ZaraOS_PATH)/cmdlines/cmdline_5.txt"

# Always needed for hardware support
BR2_PACKAGE_RPI_FIRMWARE_INSTALL_DTB=y
BR2_PACKAGE_RPI_FIRMWARE_INSTALL_DTB_OVERLAYS=y
# ┌─────────────────────────────────────────────────────────────────┐
# │ KERNEL MODULE SUPPORT                                           │
# └─────────────────────────────────────────────────────────────────┘

# Kernel module utilities for dynamic module loading
BR2_PACKAGE_KMOD=y
BR2_PACKAGE_KMOD_TOOLS=y

# ┌─────────────────────────────────────────────────────────────────┐
# │ ROOT FILESYSTEM                                                 │
# └─────────────────────────────────────────────────────────────────┘

# Use EXT4 filesystem (better than EXT2/3 for flash storage)
BR2_TARGET_ROOTFS_EXT2=y
BR2_TARGET_ROOTFS_EXT2_4=y

# Root filesystem size - 120MB should be sufficient for base system
# Increase if adding many packages or large datasets
BR2_TARGET_ROOTFS_EXT2_SIZE="256M"

# Don't generate tar archive (not needed for Pi deployment)
# BR2_TARGET_ROOTFS_TAR is not set

# ┌─────────────────────────────────────────────────────────────────┐
# │ HOST TOOLS (for image generation)                              │
# └─────────────────────────────────────────────────────────────────┘

# Tools needed for creating FAT32 boot partition
BR2_PACKAGE_HOST_DOSFSTOOLS=y

# genimage tool for creating complete disk images
BR2_PACKAGE_HOST_GENIMAGE=y

# Support for XZ compressed kernel modules
BR2_PACKAGE_HOST_KMOD_XZ=y

# MTOOLS for manipulating FAT filesystems
BR2_PACKAGE_HOST_MTOOLS=y

# Essential host tools for cross-compilation
BR2_PACKAGE_HOST_PKGCONF=y
BR2_PACKAGE_HOST_AUTOCONF=y
BR2_PACKAGE_HOST_AUTOMAKE=y
BR2_PACKAGE_HOST_LIBTOOL=y
```
